// SPDX-License-Identifier: GPL-2.0
/*
 * Copyright (C) 2019 Kontron Electronics GmbH
 */

/dts-v1/;

#include "imx8mm-kontron-n8010-som.dtsi"
#include "imx8mm-kontron-n8010-s.dtsi"

/ {
	model = "Kontron i.MX8MM N8010 S";
	compatible = "kontron,imx8mm-n8010-s", "fsl,imx8mm";
};

&usdhc2 {
	vqmmc-supply = <&nvcc_sd>;
};

// SPDX-License-Identifier: GPL-2.0
/*
 * Copyright (C) 2019 Kontron Electronics GmbH
 */

/dts-v1/;

#include "imx8mm-kontron-n8010-rev0-som.dtsi"
#include "imx8mm-kontron-n8010-s.dtsi"

/ {
	model = "Kontron i.MX8MM N8010 Rev0 S";
	compatible = "kontron,imx8mm-n8010-rev0-s", "fsl,imx8mm";
};
